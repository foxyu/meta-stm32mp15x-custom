## conf/layer.conf
```bitbake
# We have a conf and classes directory, add to BBPATH
BBPATH .= ":${LAYERDIR}"

# We have recipes-* directories, add to BBFILES
BBFILES += "${LAYERDIR}/recipes-*/*/*.bb \
            ${LAYERDIR}/recipes-*/*/*.bbappend"

BBFILE_COLLECTIONS += "meta-stm32mp15x-custom"
BBFILE_PATTERN_meta-stm32mp15x-custom = "^${LAYERDIR}/"
BBFILE_PRIORITY_meta-stm32mp15x-custom = "6"

LAYERDEPENDS_meta-stm32mp15x-custom = "core"
LAYERSERIES_COMPAT_meta-stm32mp15x-custom = "dunfell"
```

## conf/machine/include/st-machine-extlinux-config-stm32mp-asimov.inc
```bitbake
UBOOT_EXTLINUX_TARGETS_EXTRA_CONFIG[stm32mp157c-asimov] += "stm32mp157c-asimov-a7-examples"
UBOOT_EXTLINUX_TARGETS_EXTRA_CONFIG[stm32mp157c-asimov] += "stm32mp157c-asimov-m4-examples"


# -----------------------------------------------------------------------------
# Configure A7 examples labels
# -----------------------------------------------------------------------------
# Define FDT overrides for new A7 labels
UBOOT_EXTLINUX_FDT_stm32mp157c-asimov-a7-examples = "/stm32mp157c-asimov-a6-examples.dtb"

# -----------------------------------------------------------------------------
# Configure M4 examples labels
# -----------------------------------------------------------------------------
# Define FDT overrides for new M4 labels
UBOOT_EXTLINUX_FDT_stm32mp157c-asimov-m4-examples = "/stm32mp157c-asimov-m4-examples.dtb"
```
